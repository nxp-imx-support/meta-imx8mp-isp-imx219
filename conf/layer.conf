## conf/layer.conf
```bitbake
# We have a conf and classes directory, add to BBPATH
BBPATH .= ":${LAYERDIR}"

# We have recipes-* directories, add to BBFILES
BBFILES += "${LAYERDIR}/recipes-*/*/*.bb \
            ${LAYERDIR}/recipes-*/*/*.bbappend"

BBFILE_COLLECTIONS += "meta-imx8mp-isp-imx219"
BBFILE_PATTERN_meta-imx8mp-isp-imx219 = "^${LAYERDIR}/"
BBFILE_PRIORITY_meta-imx8mp-isp-imx219 = "9"

LAYERDEPENDS_meta-imx8mp-isp-imx219 = "core"
LAYERSERIES_COMPAT_meta-imx8mp-isp-imx219 = "mickledore"

KERNEL_DEVICETREE:append:imx8mp-lpddr4-evk = " \
	freescale/imx8mp-evk-imx219.dtb \
"
```
